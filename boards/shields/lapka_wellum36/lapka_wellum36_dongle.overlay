#include "lapka_wellum36_dongle.dtsi"

/ {
    chosen {
        zephyr,display = &oled;
        zmk,kscan = &mock_kscan;
    };
};

&pro_micro_i2c {
    status = "okay";

    /* SH1106 — ваш экран (SSD1106) */
    oled: sh1106@3c {
        compatible = "sinowealth,sh1106";
        reg = <0x3c>;
        width = <128>;
        height = <64>;
        segment-offset = <0>;
        page-offset = <0>;
        display-offset = <0>;
        multiplex-ratio = <63>;
        segment-remap;
        com-invdir;
        inversion-on;
        prechargep = <0x22>;
    };
};
